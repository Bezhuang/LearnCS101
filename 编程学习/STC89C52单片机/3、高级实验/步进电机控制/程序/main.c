/**************************************************************************************
*		         步进电机										  *

硬件连接：
           P0 -->矩阵键盘
					 DOUT = P3^7;	  //输出
					 CLK  = P3^6;	  //时钟
					 DIN  = P3^4;	  //输入
					 CS   = P3^5;	  //片选
					 P10   = INA
					 P11  =  INB
					 P12  =  INC
					 P13  =  INB
					 
					 OUT A+ A- B+ B-  连接电机  
					 
					 矩阵键盘：
					 0      1      2       3
					 
					 4      5      6       7
					 
					
注意事项：无																				  
***************************************************************************************/

#include "reg52.h"		       //此文件中定义了单片机的一些特殊功能寄存器
#include "lcd.h"
#include "key.h"
#include "XPT2046.h"
#include "42Motor.h"

#define u16 unsigned int 	  //对数据类型进行声明定义
#define u8 unsigned char


/*****************************************************************************/
void Display_rate();
/**************************************************************************

/*****************************************************************************/

u8 key_num;
u16 speed;
/*******************************************************************************/
bit dir,m_run;


/*******************************************************************************
* 函 数 名       : main
* 函数功能		 : 主函数
* 输    入       : 无
* 输    出    	 : 无
*******************************************************************************/
void main()
{	



	
	while(1)
				{	
							key_num=KeyDown();                    //读取键值
							switch(key_num)
								{
									case 0: m_run=~m_run; break;    //开/关
									case 1: dir=0;        break;    //正转
									case 2: dir=1;        break;		//反转
								}
					
							speed=Read_AD_Data(0x94)/4;       //取ad值
							if(speed>200)      speed-=200;     
							else               speed=1;        //
								
							if(m_run)         	Motor_Run(dir,speed);  //电机运行
				
				}	
				
}
          
/*****************************************************************************/
/*32*/
/*******************************************************************************/
